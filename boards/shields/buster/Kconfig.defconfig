## boards/shields/buster/Kconfig.defconfig
```kconfig
if SHIELD_BUSTER_LEFT

config ZMK_KEYBOARD_NAME
    default "Buster"

config ZMK_SPLIT_ROLE_CENTRAL
    default y

endif # SHIELD_BUSTER_LEFT

if SHIELD_BUSTER_LEFT || SHIELD_BUSTER_RIGHT

config ZMK_SPLIT
    default y

endif # SHIELD_BUSTER_LEFT || SHIELD_BUSTER_RIGHT
```

## boards/shields/buster/Kconfig.shield
```kconfig
config SHIELD_BUSTER_LEFT
    def_bool $(shields_list_contains,buster_left)

config SHIELD_BUSTER_RIGHT
    def_bool $(shields_list_contains,buster_right)
```
